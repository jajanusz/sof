## Kconfig
```kconfig
mainmenu "SOF $(PROJECTVERSION) Configuration"

comment "Compiler: $(CC_VERSION_TEXT)"

source "scripts/Kconfig.include"

source "src/Kconfig"

config HOST_PTABLE
	bool "Handling host page table"
	default n
	help
	  Select for host page table

config TASK_HAVE_PRIORITY_MEDIUM
	bool "Handling medium priority task"
	default n
	help
	  Select for medium priority task

config BOOT_LOADER
	bool "Boot Loader"
	default n
	help
	  Select for boot loader

config IRQ_MAP
	bool "IRQ maps"
	default n
	help
	  Select for IRQ maps

config DMA_GW
	bool "DMA Gateway"
	default n
	help
	  Select for dma gateway

config MEM_WND
	bool "Memory Windows"
	default n
	help
	  Select for memory windows

menu "Debug"

config GDB_DEBUG
	bool "GDB Stub"
	default n
	help
	  Select for GDB debugging

config DEBUG_HEAP
	bool "Heap debug"
	default n
	help
	  Select for enable heap alloc debugging

config DEBUG_BUILD
	bool "Debug build"
	default n
	help
	  Select for debug build

endmenu
```

## src/arch/xtensa/Kconfig
```kconfig
# Xtensa-specific architecture configs

menu "Architecture"

config SMP
	bool "SMP build"
	default n
	help
	  Build SMP instead of UP

endmenu
```

## src/arch/xtensa/configs/baytrail_defconfig
```kconfig
# CONFIG_SMP is not set
CONFIG_BAYTRAIL=y
# CONFIG_CHERRYTRAIL is not set
# CONFIG_HASWELL is not set
# CONFIG_BROADWELL is not set
# CONFIG_APOLLOLAKE=y is not set
# CONFIG_CANNONLAKE is not set
# CONFIG_SUECREEK is not set
# CONFIG_ICELAKE is not set
# CONFIG_DMIC is not set
CONFIG_HOST_PTABLE=y
CONFIG_TASK_HAVE_PRIORITY_MEDIUM=y
# CONFIG_BOOT_LOADER is not set
# CONFIG_IRQ_MAP is not set
# CONFIG_DMA_GW is not set
# CONFIG_MEM_WND is not set
# CONFIG_GDB_DEBUG is not set
# CONFIG_DEBUG_HEAP is not set
```

## src/arch/xtensa/configs/cannonlake_defconfig
```kconfig
CONFIG_SMP=y
# CONFIG_BAYTRAIL is not set
# CONFIG_CHERRYTRAIL is not set
# CONFIG_HASWELL is not set
# CONFIG_BROADWELL is not set
# CONFIG_APOLLOLAKE is not set
CONFIG_CANNONLAKE=y
# CONFIG_SUECREEK is not set
# CONFIG_ICELAKE is not set
CONFIG_DMIC=y
# CONFIG_HOST_PTABLE is not set
CONFIG_TASK_HAVE_PRIORITY_MEDIUM=y
CONFIG_BOOT_LOADER=y
CONFIG_IRQ_MAP=y
CONFIG_DMA_GW=y
CONFIG_MEM_WND=y
# CONFIG_GDB_DEBUG is not set
# CONFIG_DEBUG_HEAP is not set
# CONFIG_DEBUG_BUILD is not set
```

## src/arch/xtensa/configs/icelake_defconfig
```kconfig
CONFIG_SMP=y
# CONFIG_BAYTRAIL is not set
# CONFIG_CHERRYTRAIL is not set
# CONFIG_HASWELL is not set
# CONFIG_BROADWELL is not set
# CONFIG_APOLLOLAKE is not set
# CONFIG_CANNONLAKE is not set
# CONFIG_SUECREEK is not set
CONFIG_ICELAKE=y
CONFIG_DMIC=y
# CONFIG_HOST_PTABLE is not set
CONFIG_TASK_HAVE_PRIORITY_MEDIUM=y
CONFIG_BOOT_LOADER=y
CONFIG_IRQ_MAP=y
CONFIG_DMA_GW=y
CONFIG_MEM_WND=y
# CONFIG_GDB_DEBUG is not set
# CONFIG_DEBUG_HEAP is not set
# CONFIG_DEBUG_BUILD is not set
```

## src/drivers/Kconfig
```kconfig
menu "Drivers"

config DMIC
	bool "DMIC driver"
	default n
	help
	  Select for DMIC driver

endmenu
```

## src/platform/Kconfig
```kconfig
menu "Platform"

choice
	prompt "Platform"
	default APOLLOLAKE

config BAYTRAIL
	bool "Build for Baytrail"
	help
	  Select if your target platform is Baytrail-compatible

config CHERRYTRAIL
	bool "Build for Cherrytrail"
	help
	  Select if your target platform is Cherrytrail-compatible

config HASWELL
	bool "Build for Haswell"
	help
	  Select if your target platform is Haswell-compatible

config BROADWELL
	bool "Build for Broadwell"
	help
	  Select if your target platform is Broadwell-compatible

config APOLLOLAKE
	bool "Build for Apollolake"
	select CAVS
	help
	  Select if your target platform is Apollolake-compatible

config CANNONLAKE
	bool "Build for Cannonlake"
	select CAVS
	help
	  Select if your target platform is Cannonlake-compatible

config SUECREEK
	bool "Build for Suecreek"
	select CAVS
	help
	  Select if your target platform is Suecreek-compatible

config ICELAKE
	bool "Build for Icelake"
	select CAVS
	help
	  Select if your target platform is Icelake-compatible

endchoice

config CAVS
	bool
	default n

endmenu
```
